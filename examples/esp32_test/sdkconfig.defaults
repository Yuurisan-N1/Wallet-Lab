## examples/esp32_test/sdkconfig.defaults
```kconfig
# Default configuration for ESP32-S3
CONFIG_IDF_TARGET="esp32s3"

# Performance optimizations
CONFIG_COMPILER_OPTIMIZATION_PERF=y
CONFIG_ESP_DEFAULT_CPU_FREQ_MHZ_240=y

# Increase stack sizes for crypto operations
CONFIG_ESP_MAIN_TASK_STACK_SIZE=32768
CONFIG_FREERTOS_IDLE_TASK_STACKSIZE=2048

# Disable unused features to save memory
CONFIG_BOOTLOADER_LOG_LEVEL_WARN=y
CONFIG_LOG_DEFAULT_LEVEL_INFO=y
```
